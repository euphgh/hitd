## Kconfig
```kconfig
mainmenu "HIT Verilog DiffTest Configure"

choice# {{{
    prompt "Runing Mode"
    default NSC_DIFF
config NSC_DIFF
    bool "Use nemu as nscscc difftest emulator"
config NSC_NEMU
    bool "Only run nemu with nscscc SoC"
config NSC_CEMU
    bool "Only run cemu with nscscc SoC"
endchoice# }}}

config NEED_NEMU
    bool 
    default y if NSC_NEMU || NSC_DIFF

config NEED_CEMU
    bool
    default y if NSC_CEMU || (NSC_NEMU && DIFFTEST)

config NEED_TB
    bool
    default y if NSC_DIFF

choice
  prompt "Test Program"
  default TEST_UBOOT
config TEST_FUNC
  bool "NSCSCC function test"
config TEST_PERF
  bool "NSCSCC perfermance test"
config TEST_SYS
  bool "NSCSCC system test"
config TEST_UBOOT
  bool "u-boot"
config TEST_LINUX
  bool "linux"
endchoice

config BASIC_SOC
    bool
    default y if TEST_FUNC || TEST_PERF

config BOOT_SOC
    bool
    default y if TEST_SYS || TEST_UBOOT

config KERNEL_SOC
    bool
    default y if TEST_LINUX

config HAS_CONFREG
    bool
    default y if TEST_FUNC || TEST_PERF

config HAS_UART
    bool
    default y if TEST_LINUX|| TEST_UBOOT

config RESET_PC
    int 
    default 2148532224 if TEST_LINUX
    default 3217031168 if !TEST_LINUX

menu "Build Options"# {{{
choice
  prompt "Compiler"
  default CC_GCC
config CC_GCC
  bool "gcc"
config CC_GPP
  bool "g++"
config CC_CLANG
  depends on !TARGET_AM
  bool "clang"
endchoice

config CC
  string
  default "gcc" if CC_GCC
  default "g++" if CC_GPP
  default "clang" if CC_CLANG
  default "none"

choice
  prompt "Optimization Level"
  default CC_O2
config CC_O0
  bool "O0"
config CC_O1
  bool "O1"
config CC_O2
  bool "O2"
config CC_O3
  bool "O3"
endchoice

config CC_OPT
  string
  default "-O0" if CC_O0
  default "-O1" if CC_O1
  default "-O2" if CC_O2
  default "-O3" if CC_O3
  default "none"

config CCACHE_ENABLE
    bool "Enable ccache"
    default y
    help 
        use ccache to speed up compile


config CC_LTO
  depends on !TARGET_AM
  bool "Enable link-time optimization"
  default n

config CC_DEBUG
  bool "Enable debug information"
  default n

config CC_ASAN
  depends on MODE_SYSTEM
  bool "Enable address sanitizer"
  default n
endmenu# }}}

menu "Log Options"# {{{

config TRACE
  bool "Enable tracer"
  default y
  help 
      save testbench output in file

config TRACE_FILE
  depends on TRACE
  string "log file path and name"
  default "$(HITD_HOME)/tb-trace.log"
  help 
      the absolute path or relative path of log file,
      can use environment variable with makefile grammer

choice
  prompt "Truncate option"
  depends on TRACE
  default TRUNCATE_AUTO
config TRUNCATE_AUTO
  bool "Automatically truncate files based on file size"
config TRUNCATE_MANUAL
  bool "Manually set the start tick and end tick"
config TRUNCATE_NONE
  bool "Full record, no truncation"
endchoice

config TRACE_FILE_SIZE
  depends on TRACE && TRUNCATE_AUTO
  int "truncate file when trace file reaches the specified size"
  default 512
  help 
      the uint of trace file is KB
      close truncation by setting the value zero

config TRACE_START_TICK
  depends on TRACE && TRUNCATE_MANUAL
  int "trace start tick"
  default 0

config TRACE_END_TICK
  depends on TRACE && TRUNCATE_MANUAL
  int "trace end tick"
  default -1

endmenu# }}}

menu "Nemu Options"
source "src/nemu/Kconfig"
endmenu

menu "Verilog Simulate Options"
source "src/testbench/Kconfig"
endmenu
```

## configs/PerfAnalyse_defconfig
```kconfig
CONFIG_TEST_PERF=y
CONFIG_CC_DEBUG=y
# CONFIG_TRACE is not set
CONFIG_PERF_ANALISES=y
# CONFIG_WAVE_ON is not set
CONFIG_COMMIT_WAIT=y
# CONFIG_INST_TIME is not set
```

## configs/nemulinuxtest_defconfig
```kconfig
CONFIG_NSC_NEMU=y
CONFIG_TEST_LINUX=y
CONFIG_CC_DEBUG=y
# CONFIG_TRACE is not set
# CONFIG_WATCH_POINT is not set
# CONFIG_DIFFTEST is not set
CONFIG_TLB_NR=8
CONFIG_PERF_END=10
CONFIG_FREELIST_DIFF=y
CONFIG_COMMIT_WAIT=y
# CONFIG_INST_TIME is not set
```

## configs/perf_defconfig
```kconfig
CONFIG_TEST_PERF=y
CONFIG_CC_DEBUG=y
CONFIG_MIPS_RLS1=y
CONFIG_TLB_NR=8
CONFIG_CP0_DIFF=y
CONFIG_HILO_DIFF=y
CONFIG_FREELIST_DIFF=y
CONFIG_COMMIT_WAIT=y
# CONFIG_INST_TIME is not set
```

## src/nemu/Kconfig
```kconfig
menu "ISA Option"# {{{
choice
  prompt "Base ISA"
  default ISA_mips32
config ISA_x86
  bool "x86"
config ISA_mips32
  bool "mips32"
config ISA_riscv32
  bool "riscv32"
config ISA_riscv64
  bool "riscv64"
endchoice

choice
prompt "MIPS SET"
depends on ISA_mips32
default MIPS_BASIC if (TEST_FUNC || TEST_PERF)
default MIPS_RLS1 if (TEST_UBOOT || TEST_LINUX)

config MIPS_BASIC
bool "nscscc set"
config MIPS_RLS1
bool "mips32 release1"
endchoice

config ISA
  string
  default "x86" if ISA_x86
  default "mips32" if ISA_mips32
  default "riscv32" if ISA_riscv32
  default "riscv64" if ISA_riscv64
  default "none"

config ISA64
  depends on ISA_riscv64
  bool
  default y

endmenu# }}}

menu "Testing and Debugging"# {{{

config WATCH_POINT
  depends on NSC_NEMU
  bool "Watch points in simple debug"
  default y

config DWARF
    depends on NSC_NEMU
    bool "Enable C level debugger by DWARF"
    default n

config DEADLOOP
  bool "Detect Dead loop in guest program"
  default n

config DIFFTEST
  depends on NSC_NEMU
  bool "Enable differential testing for nemu"
  default y
  help
    Enable differential testing with a reference design.
    Note that this will significantly reduce the performance of NEMU.

config ITRACE
  depends on TRACE
  bool "Trace Nemu all executed Instructions"
  default y

config MTRACE
  depends on TRACE
  bool "Trace Nemu all access to Memory"
  default y

config FTRACE
  depends on TRACE && !(TEST_FUNC)
  bool "Trace Nemu all Function call(not support functional test)"
  default n

config ETRACE
  depends on TRACE
  bool "Trace Nemu all Exception trigger and return"
  default y

config GOLDEN_TRACE
  depends on TRACE
  bool "generate golden trace"
  default n

endmenu
# }}}

menu "Miscellaneous"# {{{
choice
  depends on !TARGET_AM
  prompt "Host timer"
  default TIMER_GETTIMEOFDAY
config TIMER_GETTIMEOFDAY
  bool "gettimeofday"
config TIMER_CLOCK_GETTIME
  bool "clock_gettime"
endchoice

config RT_CHECK
  bool "Enable runtime checking"
  default y

config NEMU_BAT
    bool "run nemu with batch mode"
    default n
config TLB_NR
    int "TLB entry number"
    default 16
endmenu# }}}
```

## src/testbench/Kconfig
```kconfig
menu "AXI Options"# {{{

config AXI_READ_DELAY_MIN
int "Random minimum read delay"
default 0

config AXI_READ_DELAY_MAX
int "Random maximum read delay"
range AXI_READ_DELAY_MIN 2147483647
default 1

config AXI_WRITE_DELAY_MIN
int "Random minimum write delay"
default 0

config AXI_WRITE_DELAY_MAX
int "Stop perference test after run which program"
range AXI_WRITE_DELAY_MIN 2147483647
default 1

config AXI_DWID
int "AXI bus data channal width"
default 32

config AXI_AWID
int "AXI bus address channal width"
default 32

config AXI_IDWID
int "AXI bus xID signal width"
default 4
endmenu# }}}

menu "Perference Test"# {{{
config PERF_START
int "Start to run perference test from which program"
range 1 10
default 1

config PERF_END
int "Stop perference test after run which program"
range PERF_START 10
default 1

config PERF_ANALISES
depends on TEST_PERF
bool "Record every instruction execute time"
default n
endmenu# }}}

menu "Wave and Debugging"
config WAVE_ON
bool "trace wave file"
default y

config WAVE_DIR
    depends on WAVE_ON
    string "Wave file absolutely path"
    default "$(HITD_HOME)/wave"
    help 
        the absolute path or relative path of wave diretory,
        can use environment variable with makefile grammer.
        can not add the last "/".

choice
  prompt "Wave file extension"
  depends on WAVE_ON
  default EXT_FST
config EXT_VCD
  bool "vcd"
config EXT_FST
  bool "fst"
endchoice

config WAVE_EXT
  string
  default "vcd" if EXT_VCD
  default "fst" if EXT_FST
  default "none"

config WAVE_TAIL_ENABLE
depends on WAVE_ON 
bool "control the ticks when enble wave"
default y

config WAVE_START_FROM
depends on WAVE_ON && WAVE_TAIL_ENABLE
int "When wave trace start"
default 0

config MEM_DIFF
  bool "Enable memory check when read by AXI"
  default yes

config CP0_DIFF
  bool "Enable coprocessor register 0 check"
  default no

config HILO_DIFF
  bool "Enable hi lo register check"
  default no

config FREELIST_DIFF
  bool "Enable FreeList Physical register move check"
  default no

config TLB_DIFF
  bool "Enable all TLB entries check"
  default no

config COMMIT_WAIT
  bool "Automatic exit after waiting a while without instruction commit"
  default yes
config COMMIT_TIME_LIMIT
  depends on COMMIT_WAIT
  int "Wait how many clock cycles"
  default 4096

config TTRACE
  depends on TRACE
  bool "Trace MyCPU all AXI Transition"
  default y

config CTRACE
  depends on TRACE
  bool "Trace Cache Req and States"
  default n


config BTRACE
  depends on TRACE
  bool "Trace branch predict units"
  default n

config BRANCH_STATS
  bool "Statistics branch predict rate"
  default n

config UTRACE
  depends on TRACE
  bool "Trace Uart Buffer IO"
  default n

config MEM_INDEX
  bool "Trace Mem Index "
  default n

config SNAPSHOT_AUTO
  bool "Enable Automatically save snapshot"
  default n

endmenu
```
